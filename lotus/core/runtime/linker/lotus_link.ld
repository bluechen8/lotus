/* ---- Original Script: /opt/riscv32i/riscv32-unknown-elf/lib/ldscripts/elf32lriscv.x ---- */
/* Default linker script, for normal executables */
/* Copyright (C) 2014-2017 Free Software Foundation, Inc.
   Copying and distribution of this script, with or without modification,
   are permitted in any medium without royalty provided the copyright
   notice and this notice are preserved.  */
OUTPUT_FORMAT("elf32-littleriscv", "elf32-littleriscv", "elf32-littleriscv")
OUTPUT_ARCH(riscv)
ENTRY(_start)

MEMORY
{
    all      : ORIGIN = 0x80000000, LENGTH = 0x60000000
}

PHDRS
{
  text  PT_LOAD      FLAGS(5);
  data  PT_LOAD      FLAGS(6);
  stack PT_GNU_STACK FLAGS(6);
}

SECTIONS
{
  . = 0x80000000;
  .interp         : { *(.interp) } > all :text
  .note.gnu.build-id  : { *(.note.gnu.build-id) } > all
  .hash           : { *(.hash) } > all
  .gnu.hash       : { *(.gnu.hash) } > all
  .dynsym         : { *(.dynsym) } > all
  .dynstr         : { *(.dynstr) } > all
  .gnu.version    : { *(.gnu.version) } > all
  .gnu.version_d  : { *(.gnu.version_d) } > all
  .gnu.version_r  : { *(.gnu.version_r) } > all
  .rela.dyn       :
    {
      *(.rela.init)
      *(.rela.text .rela.text.* .rela.gnu.linkonce.t.*)
      *(.rela.fini)
      *(.rela.rodata .rela.rodata.* .rela.gnu.linkonce.r.*)
      *(.rela.data .rela.data.* .rela.gnu.linkonce.d.*)
      *(.rela.tdata .rela.tdata.* .rela.gnu.linkonce.td.*)
      *(.rela.tbss .rela.tbss.* .rela.gnu.linkonce.tb.*)
      *(.rela.ctors)
      *(.rela.dtors)
      *(.rela.got)
      *(.rela.sdata .rela.sdata.* .rela.gnu.linkonce.s.*)
      *(.rela.sbss .rela.sbss.* .rela.gnu.linkonce.sb.*)
      *(.rela.sdata2 .rela.sdata2.* .rela.gnu.linkonce.s2.*)
      *(.rela.sbss2 .rela.sbss2.* .rela.gnu.linkonce.sb2.*)
      *(.rela.bss .rela.bss.* .rela.gnu.linkonce.b.*)
      PROVIDE_HIDDEN (__rela_iplt_start = .);
      *(.rela.iplt)
      PROVIDE_HIDDEN (__rela_iplt_end = .);
    } > all
  .rela.plt       :
    {
      *(.rela.plt)
    } > all
  .init           :
  {
    KEEP (*(SORT_NONE(.init)))
  } > all
  .plt            : { *(.plt) } > all
  .iplt           : { *(.iplt) } > all
  .text           :
  {
    *(.text.unlikely .text.*_unlikely .text.unlikely.*)
    *(.text.exit .text.exit.*)
    *(.text.startup .text.startup.*)
    *(.text.hot .text.hot.*)
    *(.text .stub .text.* .gnu.linkonce.t.*)
    /* .gnu.warning sections are handled specially by elf32.em.  */
    *(.gnu.warning)
  } > all
  .fini           :
  {
    KEEP (*(SORT_NONE(.fini)))
  } > all
  PROVIDE (__etext = .);
  PROVIDE (_etext = .);
  PROVIDE (etext = .);
  .rodata         : { *(.rodata .rodata.* .gnu.linkonce.r.*) } > all
  .rodata1        : { *(.rodata1) } > all
  .sdata2         :
  {
    *(.sdata2 .sdata2.* .gnu.linkonce.s2.*)
  } > all
  .sbss2          : { *(.sbss2 .sbss2.* .gnu.linkonce.sb2.*) } > all :data
  .eh_frame_hdr   : { *(.eh_frame_hdr) *(.eh_frame_entry .eh_frame_entry.*) } > all :text
  .eh_frame       : ONLY_IF_RO { KEEP (*(.eh_frame)) *(.eh_frame.*) } > all
  .gcc_except_table   : ONLY_IF_RO { *(.gcc_except_table .gcc_except_table.*) } > all
  .gnu_extab   : ONLY_IF_RO { *(.gnu_extab*) } > all
  /* These sections are generated by the Sun/Oracle C++ compiler.  */
  .exception_ranges   : ONLY_IF_RO { *(.exception_ranges*) } > all
  /* Adjust the address for the data segment.  We want to adjust up to
     the same address within the page on the next page up.  */
  . = DATA_SEGMENT_ALIGN (CONSTANT (MAXPAGESIZE), CONSTANT (COMMONPAGESIZE));
  /* Exception handling  */
  .eh_frame       : ONLY_IF_RW { KEEP (*(.eh_frame)) *(.eh_frame.*) } > all :data
  .gnu_extab      : ONLY_IF_RW { *(.gnu_extab) } > all
  .gcc_except_table   : ONLY_IF_RW { *(.gcc_except_table .gcc_except_table.*) } > all
  .exception_ranges   : ONLY_IF_RW { *(.exception_ranges*) } > all
  /* Thread Local Storage sections  */
  .tdata    :
   {
     PROVIDE_HIDDEN (__tdata_start = .);
     *(.tdata .tdata.* .gnu.linkonce.td.*)
   } > all :data
  .tbss     : { *(.tbss .tbss.* .gnu.linkonce.tb.*) *(.tcommon) } > all
  .preinit_array    :
  {
    PROVIDE_HIDDEN (__preinit_array_start = .);
    KEEP (*(.preinit_array))
    PROVIDE_HIDDEN (__preinit_array_end = .);
  } > all :data
  .init_array    :
  {
    PROVIDE_HIDDEN (__init_array_start = .);
    KEEP (*(SORT_BY_INIT_PRIORITY(.init_array.*) SORT_BY_INIT_PRIORITY(.ctors.*)))
    KEEP (*(.init_array EXCLUDE_FILE (*crtbegin.o *crtbegin?.o *crtend.o *crtend?.o ) .ctors))
    PROVIDE_HIDDEN (__init_array_end = .);
  } > all :data
  .fini_array    :
  {
    PROVIDE_HIDDEN (__fini_array_start = .);
    KEEP (*(SORT_BY_INIT_PRIORITY(.fini_array.*) SORT_BY_INIT_PRIORITY(.dtors.*)))
    KEEP (*(.fini_array EXCLUDE_FILE (*crtbegin.o *crtbegin?.o *crtend.o *crtend?.o ) .dtors))
    PROVIDE_HIDDEN (__fini_array_end = .);
  } > all
  .ctors          :
  {
    /* gcc uses crtbegin.o to find the start of
       the constructors, so we make sure it is
       first.  Because this is a wildcard, it
       doesn't matter if the user does not
       actually link against crtbegin.o; the
       linker won't look for a file to match a
       wildcard.  The wildcard also means that it
       doesn't matter which directory crtbegin.o
       is in.  */
    KEEP (*crtbegin.o(.ctors))
    KEEP (*crtbegin?.o(.ctors))
    /* We don't want to include the .ctor section from
       the crtend.o file until after the sorted ctors.
       The .ctor section from the crtend file contains the
       end of ctors marker and it must be last */
    KEEP (*(EXCLUDE_FILE (*crtend.o *crtend?.o ) .ctors))
    KEEP (*(SORT(.ctors.*)))
    KEEP (*(.ctors))
  } > all :data
  .dtors          :
  {
    KEEP (*crtbegin.o(.dtors))
    KEEP (*crtbegin?.o(.dtors))
    KEEP (*(EXCLUDE_FILE (*crtend.o *crtend?.o ) .dtors))
    KEEP (*(SORT(.dtors.*)))
    KEEP (*(.dtors))
  } > all
  .jcr            : { KEEP (*(.jcr)) } > all

  /* Start of RELRO sections */
  .data.rel.ro : {
    *(.data.rel.ro.local* .gnu.linkonce.d.rel.ro.local.*)
    *(.data.rel.ro .data.rel.ro.* .gnu.linkonce.d.rel.ro.*)
  } > all

  .got : {
    *(.got.plt) *(.igot.plt) *(.got) *(.igot)
  } > all

  /* End of RELRO sections */

  .dynamic        : { *(.dynamic) } > all

  /* Data section */
  .data           :
  {
    __DATA_BEGIN__ = .;
    *(.data .data.* .gnu.linkonce.d.*)
    SORT(CONSTRUCTORS)
  } > all :data

  .data1          : { *(.data1) } > all
  /* We want the small data sections together, so single-instruction offsets
     can access them all, and initialized data all before uninitialized, so
     we can shorten the on-disk segment size.  */
  .sdata          :
  {
    __SDATA_BEGIN__ = .;
    *(.srodata.cst16) *(.srodata.cst8) *(.srodata.cst4) *(.srodata.cst2) *(.srodata .srodata.*)
    *(.sdata .sdata.* .gnu.linkonce.s.*)
  } > all
  _edata = .; PROVIDE (edata = .);
  . = .;
  __bss_start = .;
  .sbss           :
  {
    *(.dynsbss)
    *(.sbss .sbss.* .gnu.linkonce.sb.*)
    *(.scommon)
  } > all
  .bss            :
  {
   *(.dynbss)
   *(.bss .bss.* .gnu.linkonce.b.*)
   *(COMMON)
   /* Align here to ensure that the .bss section occupies space up to _end.
      Align after .bss to keep the end symbol aligned even when there are no
      .bss input sections. */
   . = ALIGN(. != 0 ? 32 / 8 : 1);
  } > all
  . = ALIGN(32 / 8);
  . = SEGMENT_START("ldata-segment", .);
  . = ALIGN(32 / 8);
  __BSS_END__ = .;
    __global_pointer = MIN(__SDATA_BEGIN__ + 0x800,
                MAX(__DATA_BEGIN__ + 0x800, __BSS_END__ - 0x800));
  _end = .; PROVIDE (end = .);
  . = DATA_SEGMENT_END (.);

  /* .stack_dummy section doesn't contain any symbols. It is only
     used for the linker to calculate the size of stack sections, and assign
     values to stack symbols later */
  .stack_dummy (COPY):
  {
    KEEP(*(.stack*))
  } > all :NONE
  __stack_usage = SIZEOF(.stack_dummy);
  PROVIDE(__stack_top  = 0xFF000000);
  PROVIDE(__stack_size = 0x400);
  PROVIDE(__stack = __stack_top);
  ASSERT(__stack_usage <= __stack_size, "stack overflow")

  /* Stabs debugging sections.  */
  .stab          0 : { *(.stab) } > all
  .stabstr       0 : { *(.stabstr) } > all
  .stab.excl     0 : { *(.stab.excl) } > all
  .stab.exclstr  0 : { *(.stab.exclstr) } > all
  .stab.index    0 : { *(.stab.index) } > all
  .stab.indexstr 0 : { *(.stab.indexstr) } > all
  .comment       0 : { *(.comment) } > all
  .gnu.build.attributes : { *(.gnu.build.attributes .gnu.build.attributes.*) } > all
  /* DWARF debug sections.
     Symbols in the DWARF debugging sections are relative to the beginning
     of the section so we begin them at 0.  */
  /* DWARF 1 */
  .debug          0 : { *(.debug) } > all
  .line           0 : { *(.line) } > all
  /* GNU DWARF 1 extensions */
  .debug_srcinfo  0 : { *(.debug_srcinfo) } > all
  .debug_sfnames  0 : { *(.debug_sfnames) } > all
  /* DWARF 1.1 and DWARF 2 */
  .debug_aranges  0 : { *(.debug_aranges) } > all
  .debug_pubnames 0 : { *(.debug_pubnames) } > all
  /* DWARF 2 */
  .debug_info     0 : { *(.debug_info .gnu.linkonce.wi.*) } > all
  .debug_abbrev   0 : { *(.debug_abbrev) } > all
  .debug_line     0 : { *(.debug_line .debug_line.* .debug_line_end) } > all
  .debug_frame    0 : { *(.debug_frame) } > all
  .debug_str      0 : { *(.debug_str) } > all
  .debug_loc      0 : { *(.debug_loc) } > all
  .debug_macinfo  0 : { *(.debug_macinfo) } > all
  /* SGI/MIPS DWARF 2 extensions */
  .debug_weaknames 0 : { *(.debug_weaknames) } > all
  .debug_funcnames 0 : { *(.debug_funcnames) } > all
  .debug_typenames 0 : { *(.debug_typenames) } > all
  .debug_varnames  0 : { *(.debug_varnames) } > all
  /* DWARF 3 */
  .debug_pubtypes 0 : { *(.debug_pubtypes) } > all
  .debug_ranges   0 : { *(.debug_ranges) } > all
  /* DWARF Extension.  */
  .debug_macro    0 : { *(.debug_macro) } > all
  .debug_addr     0 : { *(.debug_addr) } > all
  .gnu.attributes 0 : { KEEP (*(.gnu.attributes)) } > all
  /DISCARD/ : { *(.note.GNU-stack) *(.gnu_debuglink) *(.gnu.lto_*) } > all
}
